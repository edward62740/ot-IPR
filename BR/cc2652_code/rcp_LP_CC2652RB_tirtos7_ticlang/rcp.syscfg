/**
 * @cliArgs --board "/ti/boards/LP_CC2652RB" --rtos "tirtos7" --product "simplelink_cc13xx_cc26xx_sdk@6.20.00.29"
 * @versions {"tool":"1.13.0+2553"}
 */

/**
 * Import the modules used in this configuration.
 */
const CCFG        = scripting.addModule("/ti/devices/CCFG");
const rfdesign    = scripting.addModule("/ti/devices/radioconfig/rfdesign");
const Display     = scripting.addModule("/ti/display/Display");
const Display1    = Display.addInstance();
const AESECB      = scripting.addModule("/ti/drivers/AESECB");
const AESECB1     = AESECB.addInstance();
const DMA         = scripting.addModule("/ti/drivers/DMA");
const ECDH        = scripting.addModule("/ti/drivers/ECDH");
const ECDH1       = ECDH.addInstance();
const ECDSA       = scripting.addModule("/ti/drivers/ECDSA");
const ECDSA1      = ECDSA.addInstance();
const ECJPAKE     = scripting.addModule("/ti/drivers/ECJPAKE");
const ECJPAKE1    = ECJPAKE.addInstance();
const GPIO        = scripting.addModule("/ti/drivers/GPIO");
const GPIO1       = GPIO.addInstance();
const GPIO2       = GPIO.addInstance();
const GPIO3       = GPIO.addInstance();
const GPIO4       = GPIO.addInstance();
const GPIO5       = GPIO.addInstance();
const NVS         = scripting.addModule("/ti/drivers/NVS");
const NVS1        = NVS.addInstance();
const Power       = scripting.addModule("/ti/drivers/Power");
const RF          = scripting.addModule("/ti/drivers/RF");
const SHA2        = scripting.addModule("/ti/drivers/SHA2");
const SHA21       = SHA2.addInstance();
const SPI         = scripting.addModule("/ti/drivers/SPI");
const SPI1        = SPI.addInstance();
const TRNG        = scripting.addModule("/ti/drivers/TRNG");
const TRNG1       = TRNG.addInstance();
const Watchdog    = scripting.addModule("/ti/drivers/Watchdog");
const Watchdog1   = Watchdog.addInstance();
const Settings    = scripting.addModule("/ti/posix/tirtos/Settings");
const BIOS        = scripting.addModule("/ti/sysbios/BIOS");
const Event       = scripting.addModule("/ti/sysbios/knl/Event");
const Idle        = scripting.addModule("/ti/sysbios/knl/Idle", {}, false);
const Idle2       = Idle.addInstance();
const Mailbox     = scripting.addModule("/ti/sysbios/knl/Mailbox");
const Error       = scripting.addModule("/ti/sysbios/runtime/Error");
const SysCallback = scripting.addModule("/ti/sysbios/runtime/SysCallback");
const Timestamp   = scripting.addModule("/ti/sysbios/runtime/Timestamp");
const thread      = scripting.addModule("/ti/thread/thread");

/**
 * Write custom configuration values to the imported modules.
 */
CCFG.enableBootloader         = true;
CCFG.enableBootloaderBackdoor = true;
CCFG.dioBootloaderBackdoor    = 13;
CCFG.levelBootloaderBackdoor  = "Active low";
CCFG.ccfgTemplate.$name       = "ti_devices_CCFG_CCFGCC26XXTemplate0";

Display1.$name                   = "CONFIG_DISPLAY";
Display1.uartBufferSize          = 128;
Display1.uart.$name              = "CONFIG_DISPLAY_UART";
Display1.uart.uart.txPin.$assign = "boosterpack.13";
Display1.uart.uart.rxPin.$assign = "boosterpack.19";

AESECB1.$name = "CONFIG_AESECB_0";

ECDH1.$name = "CONFIG_ECDH_0";

ECDSA1.$name = "CONFIG_ECDSA_0";

ECJPAKE1.$name = "CONFIG_ECJPAKE_0";

GPIO1.$name = "CONFIG_GPIO_BTN1";

GPIO2.$hardware = system.deviceData.board.components["BTN-2"];
GPIO2.$name     = "CONFIG_GPIO_BTN2";

GPIO3.$hardware = system.deviceData.board.components.LED_GREEN;
GPIO3.$name     = "CONFIG_GPIO_GLED";

GPIO4.$hardware = system.deviceData.board.components.LED_RED;
GPIO4.$name     = "CONFIG_GPIO_RLED";

GPIO5.$name              = "CONFIG_SPINEL_INT";
GPIO5.mode               = "Output";
GPIO5.outputStrength     = "High";
GPIO5.initialOutputState = "High";
GPIO5.gpioPin.$assign    = "boosterpack.32";

NVS1.$name                    = "CONFIG_NVSINTERNAL";
NVS1.internalFlash.$name      = "ti_drivers_nvs_NVSCC26XX0";
NVS1.internalFlash.regionBase = 0x52000;
NVS1.internalFlash.regionSize = 0x4000;

SHA21.$name = "CONFIG_SHA2_0";

SPI1.$name               = "CONFIG_SPI_1";
SPI1.mode                = "Four Pin SS Active Low";
SPI1.spi.sclkPin.$assign = "boosterpack.7";
SPI1.spi.misoPin.$assign = "boosterpack.14";
SPI1.spi.mosiPin.$assign = "boosterpack.15";
SPI1.spi.ssPin.$assign   = "boosterpack.18";

TRNG1.$name = "CONFIG_TRNG_0";

Watchdog1.$name            = "CONFIG_WATCHDOG0";
Watchdog1.watchdog.$assign = "WDT0";

BIOS.assertsEnabled = false;
BIOS.heapBaseAddr   = "__primary_heap_start__";
BIOS.heapEndAddr    = "__primary_heap_end__";

const Hwi           = scripting.addModule("/ti/sysbios/family/arm/m3/Hwi", {}, false);
Hwi.enableException = false;

const Clock      = scripting.addModule("/ti/sysbios/knl/Clock", {}, false);
Clock.tickPeriod = 10;

const Timer = scripting.addModule("/ti/sysbios/family/arm/cc26xx/Timer", {}, false);

Idle2.$name   = "powerIdle";
Idle2.idleFxn = "Power_idleFunc";

const Semaphore            = scripting.addModule("/ti/sysbios/knl/Semaphore", {}, false);
Semaphore.supportsPriority = false;

const Swi         = scripting.addModule("/ti/sysbios/knl/Swi", {}, false);
Swi.numPriorities = 6;

const Task             = scripting.addModule("/ti/sysbios/knl/Task", {}, false);
Task.defaultStackSize  = 512;
Task.idleTaskStackSize = 512;
Task.numPriorities     = 6;

Error.policy       = "Error_SPIN";
Error.printDetails = false;

const System           = scripting.addModule("/ti/sysbios/runtime/System", {}, false);
System.abortFxn        = "System_abortSpin";
System.exitFxn         = "System_exitSpin";
System.extendedFormats = "%f";
System.supportModule   = "SysCallback";

thread.deviceTypeReadOnly                    = true;
thread.pm.$name                              = "ti_thread_pm_thread_pm0";
thread.rf.$name                              = "ti_thread_rf_thread_rf0";
thread.rf.radioConfig.$name                  = "ti_devices_radioconfig_settings_ieee_15_40";
thread.rf.radioConfig.codeExportConfig.$name = "ti_devices_radioconfig_code_export_param0";
thread.network.$name                         = "ti_thread_network_thread_network0";
thread.security.$name                        = "ti_thread_security_thread_security0";

/**
 * Pinmux solution for unlocked pins/peripherals. This ensures that minor changes to the automatic solver in a future
 * version of the tool will not impact the pinmux you originally saw.  These lines can be completely deleted in order to
 * re-solve from scratch.
 */
Display1.uart.uart.$suggestSolution    = "UART0";
GPIO1.gpioPin.$suggestSolution         = "boosterpack.29";
GPIO2.gpioPin.$suggestSolution         = "boosterpack.12";
GPIO3.gpioPin.$suggestSolution         = "boosterpack.40";
GPIO4.gpioPin.$suggestSolution         = "boosterpack.39";
SPI1.spi.$suggestSolution              = "SSI0";
SPI1.spi.dmaRxChannel.$suggestSolution = "DMA_CH3";
SPI1.spi.dmaTxChannel.$suggestSolution = "DMA_CH4";
Timer.rtc.$suggestSolution             = "RTC0";
